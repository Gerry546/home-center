## layers/meta-home-center-bsp/conf/layer.conf
```bitbake
# We have a conf and classes directory, add to BBPATH
BBPATH .= ":${LAYERDIR}"

# We have recipes-* directories, add to BBFILES
BBFILES += "${LAYERDIR}/recipes-*/*/*.bb \
            ${LAYERDIR}/recipes-*/*/*.bbappend"

BBFILE_COLLECTIONS += "meta-homecenter-bsp"
BBFILE_PATTERN_meta-homecenter-bsp = "^${LAYERDIR}/"
BBFILE_PRIORITY_meta-homecenter-bsp = "20"

LAYERDEPENDS_meta-homecenter-bsp = "\
    core \
    rauc \
    raspberrypi \
"

LAYERSERIES_COMPAT_meta-homecenter-bsp = "kirkstone"
```

## layers/meta-home-center-distro/conf/distro/homely.conf
```bitbake
DISTRO = "homely"
DISTRO_NAME = "Homely (Home Center Distro)"
DISTRO_VERSION = "0.0.2"

SDK_VENDOR = "-homelysdk"
MAINTAINER = "Tom Geelen <t.f.g.geelen@gmail.com>"

PREFERRED_PROVIDER_virtual/kernel:qemu-homely-x86-64 = "linux-yocto"
PREFERRED_PROVIDER_virtual/kernel:hometerminal-cm4 = "linux-raspberrypi"

DISTRO_FEATURES = "\
    ${DISTRO_FEATURES_DEFAULT} \
    \
    systemd \
    \
    rauc \
"

# Let's ensure all is dynamically linked
require conf/distro/include/no-static-libs.inc

# And add some security flags
require conf/distro/include/security_flags.inc

# Prevent stacking up old builds and do not symlink everything
IMAGE_NAME = "${IMAGE_BASENAME}-${MACHINE}"
IMAGE_LINK_NAME = ""

# Default the temp directory name in the build folder to tmp
TCLIBCAPPEND = ""

# Systemd is part of the distro features so let's remove sysvinit
DISTRO_FEATURES_BACKFILL_CONSIDERED = "sysvinit"
VIRTUAL-RUNTIME_init_manager = "systemd"
VIRTUAL-RUNTIME_initscripts = ""

# Default for the distro to U-Boot
RPI_USE_U_BOOT:hometerminal-cm4 = "1"

#Enable tftp + nfs
# ENABLE_TFTP_NFS:hometerminal-cm4 = "1"
```

## layers/meta-home-center-distro/conf/layer.conf
```bitbake
# We have a conf and classes directory, add to BBPATH
BBPATH .= ":${LAYERDIR}"

# We have recipes-* directories, add to BBFILES
BBFILES += "${LAYERDIR}/recipes-*/*/*.bb \
            ${LAYERDIR}/recipes-*/*/*.bbappend"

BBFILE_COLLECTIONS += "meta-homecenter-distro"
BBFILE_PATTERN_meta-homecenter-distro = "^${LAYERDIR}/"
BBFILE_PRIORITY_meta-homecenter-distro = "20"

LAYERDEPENDS_meta-homecenter-distro = "core"
LAYERSERIES_COMPAT_meta-homecenter-distro = "kirkstone"
```

## layers/meta-home-center-distro/conf/machine/hometerminal-cm4.conf
```bitbake
#@TYPE: Machine
#@NAME: RaspberryPi 4 Compute Module in the reterminal
#@DESCRIPTION: Machine configuration for the RaspberryPi 4 in 64 bits mode

MACHINEOVERRIDES = "raspberrypi4:raspberrypi4-64:${MACHINE}"

require conf/machine/raspberrypi4-64.conf

# We want the UART so that we can easily use picocom
ENABLE_UART = "1"
# Since several devices are connected to the I2C bus (such as the screen) we will need I2C
ENABLE_I2C = "1"
KERNEL_MODULE_AUTOLOAD += "i2c-dev"
KERNEL_MODULE_AUTOLOAD += "als_ltr30x"
KERNEL_MODULE_AUTOLOAD += "lis331dlh-i2c"

# Enable Reterminal hardware
ENABLE_RETERMINAL = "1"

MACHINE_FEATURES += "\
    usbhost \
    touchscreen \
    wifi \
    rtc \
"

# Add additional dtbo files to the devicetree
RPI_KERNEL_DEVICETREE_OVERLAYS:append = "\
    overlays/i2c3.dtbo \
    overlays/vc4-kms-v3d-pi4.dtbo \
    overlays/reterminal.dtbo \
"

WKS_FILE = "hometerminal.wks.in"

IMAGE_FSTYPES = "\
    ext4 \
    tar.xz \
    wic \
    wic.bz2 \
    wic.bmap \
"
```

## layers/meta-home-center-distro/conf/machine/qemu-homely-arm64.conf
```bitbake
#@TYPE: Machine
#@NAME: QEMU ARMv8 machine
#@DESCRIPTION: Machine configuration for running an ARMv8 system on QEMU

MACHINEOVERRIDES = "qemuarm64:${MACHINE}"

require conf/machine/qemuarm64.conf

KMACHINE:qemu-homely-arm64 = "qemuarm64"

EXTRA_IMAGE_FEATURES += "debug-tweaks"
EXTRA_IMAGE_FEATURES += "ssh-server-openssh"
```

## layers/meta-home-center-distro/conf/machine/qemu-homely-x86-64.conf
```bitbake
#@TYPE: Machine
#@NAME: QEMU x86-64 machine
#@DESCRIPTION: Machine configuration for running an x86-64 system on QEMU

MACHINEOVERRIDES = "qemux86-64:${MACHINE}"

require conf/machine/qemux86-64.conf

PREFERRED_RPROVIDER_virtual-grub-bootconf = "rauc-qemu-grubconf"

KMACHINE:qemu-homely-x86-64 = "qemux86-64"

MACHINE_FEATURES += "\
    pcbios \
    efi \
"

WKS_FILE = "qemux86-homely-grub-efi.wks"
do_image_wic[depends] += "boot-image:do_deploy"

IMAGE_FSTYPES += "wic ext4 tar.bz2"

EXTRA_IMAGEDEPENDS += "ovmf"
EXTRA_IMAGE_FEATURES += "debug-tweaks"
EXTRA_IMAGE_FEATURES += "ssh-server-openssh"
```

## layers/meta-home-center/conf/layer.conf
```bitbake
# We have a conf and classes directory, add to BBPATH
BBPATH .= ":${LAYERDIR}"

# We have recipes-* directories, add to BBFILES
BBFILES += "${LAYERDIR}/recipes-*/*/*.bb \
            ${LAYERDIR}/recipes-*/*/*.bbappend"

BBFILE_COLLECTIONS += "meta-homecenter"
BBFILE_PATTERN_meta-homecenter = "^${LAYERDIR}/"
BBFILE_PRIORITY_meta-homecenter = "20"

LAYERDEPENDS_meta-homecenter = "\
    meta-homecenter-distro \
"

LAYERSERIES_COMPAT_meta-homecenter = "kirkstone"
```
